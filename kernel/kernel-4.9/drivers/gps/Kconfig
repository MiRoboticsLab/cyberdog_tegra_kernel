## kernel/kernel-4.9/drivers/gps/Kconfig
```kconfig
config XIAOMI_GPS_UART_DRIVER
tristate "Xiaomi GPS uart Driver"
        default y
	help
	  Support for XIAOMI GPS uart driver
```

## kernel/kernel-4.9/drivers/iio/magnetometer/ak0991x/Kconfig
```kconfig
#
# ak0991x Magnetometer sensors
#

config IIO_AKM_MAGN_AK0991X
	tristate "Asahi Kasei AK0991X 3-Axis Magnetometer"
	select IIO_BUFFER
	select IIO_TRIGGERED_BUFFER
	help
	  Say yes here to build support for Asahi Kasei AK09911/AK09912 3-Axis Magnetometer.

config IIO_AKM_MAGN_AK0991X_I2C
	tristate "support I2C bus connection"
	depends on IIO_AKM_MAGN_AK0991X && I2C
	help
	  Say y here is you have AK0991X hooked to an I2C bus.

config IIO_AKM_MAGN_AK0991X_SPI
	tristate "support SPI bus connection"
	depends on IIO_AKM_MAGN_AK0991X && SPI
	help
	  Say y here if you have AK0991X hooked to an SPI bus.
```

## kernel/kernel-4.9/drivers/iio/proximity/inv_chx01/Kconfig
```kconfig
#
# chx01 drivers for Invensense CH-x01 device
#
# source "drivers/iio/proximity/inv_chx01/Kconfig"
#

config CHIRP_I2C
	tristate "Invensense Chirp CH-x01 devices (I2C)"
	depends on I2C_MUX 
	select CHIRP
	select REGMAP_I2C
	select IIO_BUFFER
	select IIO_TRIGGERED_BUFFER
	help
	  This driver supports the Invensense CH-101/CH-201 ultra-low power 
	  ultrasonic Time-of-Flight (ToF) range sensor over I2C.
	  This driver can be built as a module. The module will be called
	  chirp-i2c

choice
	prompt "Chirp device name"
	depends on CHIRP_I2C

config CH101_I2C
	bool "Invensense CH-101 devices"
	help
		Select this if you are using a Chirp CH-101 chip

config CH201_I2C
	bool "Invensense CH-201 devices"
	help
		Select this if you are using a Chirp CH-201 chip

endchoice
```

## kernel/kernel-4.9/drivers/input/light_sensor/Kconfig
```kconfig
#
# chx01 drivers for Invensense CH-x01 device
#
# source "drivers/iio/proximity/inv_chx01/Kconfig"
#

config BU27030_I2C
	tristate "RohM BU27030 devices (I2C)"
	help
	  This driver supports the RohM BU27030 light sensor over I2C.
	  This driver can be built as a module. The module will be called
```
