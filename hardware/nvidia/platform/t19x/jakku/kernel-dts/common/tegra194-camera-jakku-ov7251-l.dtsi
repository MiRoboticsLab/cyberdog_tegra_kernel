#include "tegra194-camera-ov7251-l.dtsi"
#include "dt-bindings/clock/tegra194-clock.h"

#define	CAM3_PWDN	20

/{
	i2c@3180000 {
		ov7251@61 {
			clocks = <&bpmp_clks TEGRA194_CLK_EXTPERIPH3>,
				 <&bpmp_clks TEGRA194_CLK_PLLP_OUT0>;
			clock-names = "extperiph3", "pllp_grtba";
			mclk = "extperiph3";
			clock-frequency = <24000000>;
			pwdn-gpios = <&gpio_expand1 CAM3_PWDN GPIO_ACTIVE_HIGH>;
			vana-supply = <&avdd_cam3_2v8>;
			vif-supply = <&iovdd_cam_1v8>;
		};
	};
};
