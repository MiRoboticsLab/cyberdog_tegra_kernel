/*
 *
 * Copyright (c) 2021 Beijing Xiaomi Mobile Software Co., Ltd. All rights reserved.
 *
 * This program is free software; you can redistribute it and/or modify
 * it under the terms of the GNU General Public License as published by
 * the Free Software Foundation; version 2 of the License.
 *
 * This program is distributed in the hope that it will be useful, but WITHOUT
 * ANY WARRANTY; without even the implied warranty of MERCHANTABILITY or
 * FITNESS FOR A PARTICULAR PURPOSE.  See the GNU General Public License for
 * more details.
 */

#include "common/tegra194-camera-jakku-ov13b10.dtsi"
#include "common/tegra194-camera-jakku-ov7251-l.dtsi"
#include "common/tegra194-camera-jakku-ov7251-r.dtsi"
